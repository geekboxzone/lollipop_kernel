## geekbox/Kconfig
```kconfig
menu "Geekbox Platform Options"

	config GEEKBOX_UBUNTU
		bool "Ubuntu or other Linux Distros support"
		default n

	config GEEKBOX_OVERCLOCK
		bool "Overclock support"
		default n

endmenu
```
